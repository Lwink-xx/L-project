# pse84 register map
Vendor: Infineon Technologies; Series: PSE84; File version: 1.0
CPU: CM33 r0p1, little endian, MPU, FPU, VTOR, 3 interrupt priority bits
Registers are 32-bit, read-write, reset 0x0 unless marked. A register's access mark holds for its fields unless they carry their own. Offsets are from the block's base; lines under a group give offsets from that group; [hi:lo] are bit positions; {n}, {i} and the like mark numbered series; 'fields as' and 'values as' point back to an identical list; <NAME> marks a mode.

## Memory map
0x42000000 PERI0 size 0x10000 — Peripheral interconnect
0x42020000 PPC0 size 0x10000 — Peripheral Protection Controller
0x42040000 PERI_PCLK0 size 0x20000 — Peripheral PCLK groups
0x42200000 RRAMC0 size 0x20000 — RRAM controller registers
0x42220000 RAMC_PPU0 size 0x1000 — Power Policy Unit Registers for System RAM
0x42221000 RAMC_PPU1 size 0x1000
0x42223000 ICACHE0 size 0x1000 — CM33_0/1 CA APB interface
0x42225000 CPUSS_PPU size 0x1000 — Power Policy Unit Registers for CPUSS
0x42230000 RAMC0 size 0x10000 — RAMC0/1/2
0x42240000 RAMC1 size 0x10000
0x42260000 MXCM33 size 0x10000 — MXCM33-0/1
0x42270000 DW0 size 0x10000 — DW-0/1
0x42280000 DW1 size 0x10000
0x42290000 CPUSS size 0x4000 — SYSCPUSS registers
0x42294000 MS_CTL_2_1 size 0x4000 — Master control registers
0x42298000 CPUSS_SL_CTL size 0x10 — SYSCPUSS Internal slave control registers
0x422A0000 IPC0 size 0x10000 — IPC
0x422B0000 FAULT size 0x10000 — Fault structures
0x42400000 SRSS size 0x10000 — SRSS Core Registers
0x42410000 PWRMODE size 0x10000 — SRSS Power Mode Control Registers
0x42420000 RTC size 0x10000 — SRSS RTC Registers
0x42430000 DEBUG600 size 0x100
0x42430100 M0SECCPUSS_STATUS size 0x100 — Cortex-M0+ Secured CPU subsystem
0x42440000 CRYPTO size 0x10000 — Cryptography component
0x42800000 HSIOM size 0x4000 — IO Matrix (IOM)
0x42810000 GPIO size 0x10000 — IO port control/configuration
0x42820000 SMARTIO size 0x10000 — Programmable IO configuration
0x42840000 CANFD0 size 0x20000 — CAN Controller
0x42860000 TCPWM0 size 0x20000 — Timer/Counter/PWM
0x42880000 LPCOMP size 0x10000 — Low Power Comparators
0x42990000 SCB0 size 0x10000 — Serial Communications Block (SPI/UART/I2C)
{0x42980000+0x10000*n} SCB{n} size 0x10000 (n=2..11)
0x42A50000 I3C size 0x10000 — I3C controller top
0x42C10000 ETH0 size 0x10000 — Ethernet Interface
0x42D00000 SCB1 size 0x10000
0x42D80000 MXNNLITE_2_0 size 0x1000
0x42E00000 CTBL0 size 0x10000 — Continuous Time Block Lite
0x42E10000 CTBL1 size 0x10000
0x42E40000 PTC size 0x10000 — Programmable Threshold Comparator
0x42E60000 DAC0 size 0x10000 — DAC
0x42E70000 DAC1 size 0x10000
0x42E80000 SAR size 0x10000
0x42ED0000 ACTRLR size 0x10000 — Autonomnous Controller
0x42EE0000 INFRA size 0x10000 — LPPASS infrastructure
0x42EF0000 LPPASS_MMIO size 0x10000 — LPPASS top-level MMIO
0x44000000 PERI1 size 0x10000
0x44020000 PPC1 size 0x10000
0x44040000 PERI_PCLK1 size 0x20000
0x44100000 PPU_APPCPUSS size 0x1000 — Power Policy Unit Registers for APPCPUSS PPU
0x44101000 PPU_CM55_0 size 0x1000 — Power Policy Unit Registers for CM55_0 PPU
0x44103000 PD size 0x20 — Power Domain Controller
0x44160000 MXCM55 size 0x10000 — MXCM55-0/1
0x441A0000 SAXI_DMAC size 0x10000 — AXI DMAC
0x441C0000 APPCPUSS size 0x4000 — APPCPUSS registers
0x441C4000 MS_CTL size 0x4000 — Master control registers
0x441C8000 APPCPUSS_SL_CTL size 0x10 — APPCPUSS Internal slave control registers
0x441D0000 IPC1 size 0x10000
0x44400000 PDM0 size 0x10000 — PDM
0x44410000 TDM0 size 0x10000 — TDM
0x44440000 SMIF0 size 0x40000 — SMIF subsystem (1 SMIF cores, no bridge, 1 cache_block and 1 Q_LPI expander)
0x44480000 SMIF1 size 0x40000
0x44600000 U550 size 0x10000 — Top level section for IP generation only, contains IP memory map
0x44640000 SOCMEM size 0x40000 — SoC memory
0x44800000 GFXSS size 0x4000
0x44810000 SDHC0 size 0x10000 — SD/eMMC Host Controller
0x44820000 SDHC1 size 0x10000
0x44900000 USBHS size 0x80000 — Regmap for both Subsystem and Controller IP

## Interrupts
0 ioss_interrupts_gpio_0 (CPUSS) — GPIO Port Interrupt #0
1 ioss_interrupts_gpio_2 (CPUSS) — GPIO Port Interrupt #2
2 ioss_interrupts_gpio_3 (CPUSS) — GPIO Port Interrupt #3
{n-2} ioss_interrupts_gpio_{n} (CPUSS) (n=5..21) — GPIO Port Interrupt #{n}
20 ioss_interrupts_sec_gpio_0 (CPUSS) — GPIO Port Secure Interrupt #0
21 ioss_interrupts_sec_gpio_2 (CPUSS) — GPIO Port Secure Interrupt #2
22 ioss_interrupts_sec_gpio_3 (CPUSS) — GPIO Port Secure Interrupt #3
{n+18} ioss_interrupts_sec_gpio_{n} (CPUSS) (n=5..21) — GPIO Port Secure Interrupt #{n}
40 ioss_interrupt_vdd (CPUSS) — GPIO Supply Detect Interrupt
41 ioss_interrupt_gpio (CPUSS) — GPIO All Ports
42 ioss_interrupt_sec_gpio (CPUSS) — GPIO All Ports - Secured version
43 scb_0_interrupt (CPUSS) — Serial Communication Block #0 (DeepSleep capable)
44 srss_interrupt (CPUSS) — Other combined Interrupts for srss (LVD, CLKCAL)
45 lpcomp_interrupt (CPUSS) — LPCOMP
{n+46} m55appcpuss_interrupts_ipc_dpslp_{n} (CPUSS) (n=0..7) — m55appcpuss Inter Process Communication Interrupt #{n}
54 srss_interrupt_wdt (CPUSS) — Interrupt for WDT
55 srss_interrupt_mcwdt_0 (CPUSS) — Interrupt for MCWDT[]
56 srss_interrupt_rtc (CPUSS) — Interrupt for RTC
57 pass_interrupt_lppass (CPUSS) — LPPASS interrupt
58 pass_interrupt_fifo (CPUSS) — LPPASS FIFO interrupt
59 ioss_interrupts_gpio_1 (CPUSS) — GPIO Port Interrupt #1 (SMIF0)
60 ioss_interrupts_gpio_4 (CPUSS) — GPIO Port Interrupt #4 (SMIF1)
63 srss_interrupt_main_ppu (CPUSS) — Interrupt from Main PPU
64 srss_interrupt_srss_pd1_ppu (CPUSS) — Interrupt from PD1 PPU
65 m33syscpuss_interrupt_ppu_sramc0 (CPUSS) — PPU SRAM0
66 m33syscpuss_interrupt_ppu_sramc1 (CPUSS) — PPU SRAM1
67 m33syscpuss_interrupt_ppu_cpuss (CPUSS) — cpuss[0] PPU Interrupt
68 mxu55_interrupt_ppu (CPUSS) — Interrupt requests of mxu55.PPU
69 socmem_interrupt_ppu (CPUSS) — Interrupt requests of socmem.PPU
{n+70} m33syscpuss_interrupts_ipc_dpslp_{n} (CPUSS) (n=0..7) — m33syscpuss Inter Process Communication Interrupt #{n}
78 mxnnlite_interrupt_mxnnlite (CPUSS) — Interrupt of MXNNLITE
79 m33syscpuss_interrupts_cm33_0_cti_0 (CPUSS)
80 m33syscpuss_interrupts_cm33_0_cti_1 (CPUSS)
81 m33syscpuss_interrupt_cm33_0_fp (CPUSS) — CM33 0 Floating Point Interrupt
{n+82} m33syscpuss_interrupts_dw0_{n} (CPUSS) (n=0..15) — cpuss[0] DataWire #0, Channel #{n}
98 m55appcpuss_interrupts_axidmac_0 (CPUSS)
99 m55appcpuss_interrupts_axidmac_1 (CPUSS)
100 m55appcpuss_interrupts_axidmac_2 (CPUSS)
101 m55appcpuss_interrupts_axidmac_3 (CPUSS)
102 smif_0_smif0_interrupt_nsec (CPUSS) — SMIF0 Port0 non-secure interrupt
103 smif_0_smif0_interrupt_sec (CPUSS) — SMIF0 Port0 secure interrupt
104 smif_1_smif0_interrupt_nsec (CPUSS) — SMIF1 Port0 non-secure interrupt
105 smif_1_smif0_interrupt_sec (CPUSS) — SMIF1 Port0 secure interrupt
106 canfd_0_interrupts0_0 (CPUSS) — CAN #0, Interrupt0, Channel#0
107 canfd_0_interrupts1_0 (CPUSS) — CAN #0, Interrupt1, Channel#0
108 canfd_0_interrupts0_1 (CPUSS) — CAN #0, Interrupt0, Channel#1
109 canfd_0_interrupts1_1 (CPUSS) — CAN #0, Interrupt1, Channel#1
{n+110} tcpwm_0_interrupts_{n} (CPUSS) (n=0..7) — TCPWM, 32-bit Counter #{n}
{n-138} tcpwm_0_interrupts_{n} (CPUSS) (n=256..279) — TCPWM, 16-bit Counter #{n-256}
{n+141} scb_{n}_interrupt (CPUSS) (n=1..11)
153 mxu55_interrupt_npu (CPUSS) — Interrupt requests of armu55 (NPU)
154 sdhc_0_interrupt_general (CPUSS) — SDHC0
155 sdhc_0_interrupt_wakeup (CPUSS) — SDHC0
156 sdhc_1_interrupt_general (CPUSS) — SDHC1
157 sdhc_1_interrupt_wakeup (CPUSS) — SDHC1
158 tdm_0_interrupts_rx_0 (CPUSS) — TDM0 Audio interrupt RX Structure#0
159 tdm_0_interrupts_tx_0 (CPUSS) — TDM0 Audio interrupt TX Structure#0
160 tdm_0_interrupts_rx_1 (CPUSS) — TDM0 Audio interrupt RX Structure#1
161 tdm_0_interrupts_tx_1 (CPUSS) — TDM0 Audio interrupt TX Structure#1
162 gfxss_interrupt_gpu (CPUSS) — Interrupt from GPU.
163 gfxss_interrupt_dc (CPUSS) — Interrupt from DC.
164 gfxss_interrupt_mipidsi (CPUSS) — Interrupt from MIPIDSI.
165 pdm_0_interrupts_0 (CPUSS) — PDM interrupt Structure#0
166 pdm_0_interrupts_1 (CPUSS) — PDM interrupt Structure#1
167 pdm_0_interrupts_2 (CPUSS) — PDM interrupt Structure#2
168 pdm_0_interrupts_3 (CPUSS) — PDM interrupt Structure#3
169 pdm_0_interrupts_4 (CPUSS) — PDM interrupt Structure#4
170 pdm_0_interrupts_5 (CPUSS) — PDM interrupt Structure#5
171 eth_interrupt_eth_0 (CPUSS) — ETH Interrupt#0
172 eth_interrupt_eth_1 (CPUSS) — ETH Interrupt#1
173 eth_interrupt_eth_2 (CPUSS) — ETH Interrupt#2
174 usbhs_interrupt_usbhsctrl (CPUSS) — Interrupt of Controller core
175 usbhs_interrupt_usbhsss (CPUSS) — Interrupt of Subsystem
176 i3c_interrupt (CPUSS)
177 m33syscpuss_interrupt_msc (CPUSS)
178 crypto_interrupt (CPUSS)
179 m33syscpuss_interrupts_fault_0 (CPUSS)
180 m33syscpuss_interrupts_fault_1 (CPUSS)
{n+181} m33syscpuss_interrupts_dw1_{n} (CPUSS) (n=0..15) — cpuss[0] DataWire #1, Channel #{n}

## Licence text in the file
(c) (2016-2025), Cypress Semiconductor Corporation (an Infineon company) or an affiliate of Cypress Semiconductor Corporation. . SPDX-License-Identifier: Apache-2.0 . Licensed under the Apache License, Version 2.0 (the "License"); you may not use this file except in compliance with the License. You may obtain a copy of the License at http://www.apache.org/licenses/LICENSE-2.0 . Unless required by applicable law or agreed to in writing, software distributed under the License is distributed on an "AS IS" BASIS, WITHOUT WARRANTIES OR CONDITIONS OF ANY KIND, either express or implied. See the License for the specific language governing permissions and limitations under the License.
